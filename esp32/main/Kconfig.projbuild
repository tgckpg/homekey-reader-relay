## esp32/main/Kconfig.projbuild
```kconfig
menu "Home Key presence / sleep"
    config HOMEKEY_PRESENCE_ENABLED
        bool "Use LD2410S OT2 to control deep sleep"
        depends on IDF_TARGET_ESP32C3
        default y
        help
            Keep LD2410S powered. OT2 HIGH means present, LOW means absent.
            Deep sleep disconnects BLE; Go must reconnect on every wake.
            Disable for bench testing without the sensor.

    config HOMEKEY_PRESENCE_GPIO
        int "LD2410S OT2 GPIO"
        depends on HOMEKEY_PRESENCE_ENABLED
        range 0 5
        default 1
        help
            C3 deep-sleep wake requires GPIO0-5. GPIO3/4 are reserved for
            PN532 UART and rejected at compile time. Avoid strapping GPIO2.

    config HOMEKEY_PRESENCE_ABSENCE_MS
        int "Additional absence confirmation (ms)"
        depends on HOMEKEY_PRESENCE_ENABLED
        range 100 10000
        default 1000
        help
            Added after the sensor's own absence delay. An active NFC session
            finishes before sleep is considered.

    config HOMEKEY_PRESENCE_BOOT_GRACE_MS
        int "Minimum awake time after reset / power-on (ms)"
        depends on HOMEKEY_PRESENCE_ENABLED
        range 0 60000
        default 10000
        help
            Gives the sensor time to start and USB time to connect. Skipped
            on GPIO wake from deep sleep. Does not delay NFC startup.
endmenu
```

## esp32/sdkconfig.defaults
```kconfig
CONFIG_BT_ENABLED=y
CONFIG_BT_NIMBLE_ENABLED=y
CONFIG_BT_NIMBLE_ROLE_PERIPHERAL=y
CONFIG_BT_NIMBLE_ROLE_BROADCASTER=y
CONFIG_BT_NIMBLE_GATT_SERVER=y
CONFIG_BT_NIMBLE_GAP_SERVICE=y
```

## esp32/tools/ld2410s-c3-calib/main/Kconfig.projbuild
```kconfig
menu "LD2410S bench"
    config BENCH_UART_TX
        int "ESP32 UART TX GPIO (connect to sensor RX)"
        range 0 10
        default 4
    config BENCH_UART_RX
        int "ESP32 UART RX GPIO (connect to sensor TX/OT1)"
        range 0 10
        default 3
    config BENCH_AP_SSID
        string "Bench access point SSID"
        default "LD2410S-Bench"
    config BENCH_AP_PASSWORD
        string "Bench access point password (8 to 63 characters)"
        default "calibrate2410"
    config BENCH_STA_SSID
        string "Optional home Wi-Fi SSID (empty = AP only)"
        default ""
    config BENCH_STA_PASSWORD
        string "Optional home Wi-Fi password"
        default ""
endmenu
```

## esp32/tools/ld2410s-c3-calib/sdkconfig.defaults
```kconfig
CONFIG_IDF_TARGET="esp32c3"
CONFIG_ESPTOOLPY_FLASHSIZE_2MB=y
CONFIG_ESP_CONSOLE_USB_SERIAL_JTAG=y
CONFIG_ESP_CONSOLE_SECONDARY_NONE=y
CONFIG_COMPILER_OPTIMIZATION_SIZE=y
CONFIG_HTTPD_MAX_REQ_HDR_LEN=1024
CONFIG_HTTPD_MAX_URI_LEN=128
```
